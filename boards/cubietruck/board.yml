## boards/cubietruck/board.yml
```yaml
board:
  arch: arm
  kernel: linux-4.12.0
  kernel_config: linux-4.12-sunxi
  uboot: "2017.07"
  uboot_config: 2017.07-minimal
  boot_script: boot-sunxi-default.j2
  image: default.j2
  linux_dtb: sun7i-a20-cubietruck.dtb
  linux_image: zImage
  uboot_image: u-boot-sunxi-with-spl.bin
  root: /dev/mmcblk0p2
  rootfs: automatic
```

## boards/orangepi-zero/board.yml
```yaml
board:
  arch: arm
  kernel: linux-4.12.0
  kernel_config: linux-4.12-sunxi
  uboot: "2017.07"
  uboot_config: 2017.07-minimal
  boot_script: boot-sunxi-default.j2
  image: default.j2
  linux_dtb: sun8i-h2-plus-orangepi-zero.dtb
  linux_image: zImage
  uboot_image: u-boot-sunxi-with-spl.bin
  root: /dev/mmcblk0p2
```
